## firmware/components/hosted_kconfig_shim/Kconfig
```kconfig
menu "Leumpang Ajeg: shim Kconfig esp_hosted"
    config ESP_HOSTED_HOST_USB_CDC_ACM_MANIFEST
        bool
        default n
    config ESP_HOSTED_HOST_USB_CHERRYUSB_MANIFEST
        bool
        default n
    config ESP_HOSTED_HOST_USB_RNDIS_MANIFEST
        bool
        default n
    config ESP_HOSTED_CP_TINYUSB_MANIFEST
        bool
        default n
endmenu
```

## firmware/radio/esp32/main/Kconfig.projbuild
```kconfig
menu "Leumpang Radio"
    config LA_RADIO_TX
        int "GPIO TX ke robot (ke RX robot)"
        default 26
        help
            26/27 tersedia di DevKit WROOM-32 dan ESP32-PICO-KIT (GPIO16/17 dipakai flash di PICO-D4).
    config LA_RADIO_RX
        int "GPIO RX dari robot (dari TX robot)"
        default 27
    config LA_RADIO_LED
        int "GPIO LED status (-1 = tanpa LED)"
        default 2
        help
            DevKitC: LED biru di GPIO2. ESP32-PICO-KIT tidak punya LED pengguna: isi -1 atau pasang LED sendiri.
endmenu
```
